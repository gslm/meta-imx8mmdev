## conf/layer.conf
```bitbake
# We have a conf and classes directory, add to BBPATH
BBPATH .= ":${LAYERDIR}"

# We have recipes-* directories, add to BBFILES
BBFILES += "${LAYERDIR}/recipes-*/*/*.bb \
            ${LAYERDIR}/recipes-*/*/*.bbappend"

BBFILE_COLLECTIONS += "meta-plant"
BBFILE_PATTERN_meta-plant = "^${LAYERDIR}/"
BBFILE_PRIORITY_meta-plant = "6"

LAYERDEPENDS_meta-plant= "core"
LAYERSERIES_COMPAT_meta-plant = "hardknott"
```
